## components/audiomatrix/Kconfig.projbuild
```kconfig
menu "Audiomatrix configuration"
    config AM_MQTT_HA_TOPIC
        string "Hommeassistant MQTT topic"
        default "homeassistant"
        help
            Hommeassistant MQTT topic
    config AM_MQTT_DEVICE_TOPIC
        string "Device MQTT topic"
        default "myhome/audiomatrix"
        help
            Device MQTT topic
    config AM_DEVICE_NAME
        string "Hommeassistant device name"
        default "Audiomatrix"
        help
            Hommeassistant device name
    config AM_DEVICE_MANUFACTURER
        string "Device manufacturer"
        default "Vedrel"
        help
            Manufacturer of device
    config AM_DEVICE_MODEL
        string "Device model name"
        default "Audiomatrix switch"
        help
            Model name of device
    config AM_DEVICE_MODEL_ID
        string "Device model ID"
        default "Audiomatrix switch 3x4"
        help
            Model ID of device
    config AM_DEVICE_IN_PORTS
        int "Number of input ports"
        default 3
        help
            Number of input ports    
    config AM_DEVICE_OUT_PORTS
        int "Number of output ports"
        default 4
        help
            Number of output ports    
    config AM_DEVICE_HW
        string "Device hardware version"
        default "1.0.0"
        help
            Version of device hardware  
    config AM_CONFIGURATION_URL
        string "Device confuguration URL"
        default "http://audiomatrix.local"
        help
            Device confuguration URL

endmenu
```

## components/events/Kconfig.projbuild
```kconfig
menu "Application events configuration "

    config CALLBACK_SIZE
        int "Size of Callback"
        range 1 32
        default 32
        help
            Size of Callback.

    config QUEUE_SIZE
        int "Size of queue"
        range 1 64
        default 32
        help
            queue of Callback.

endmenu
```

## components/home_mqtt_client/Kconfig.projbuild
```kconfig
menu "MQTT configuration"

    config BROKER_URL
        string "Broker URL"
        default "mqtt://mqtt.local"
        help
            URL of the broker to connect to
    config BROKER_USER
        string "Broker user"
        default "mqtt"
        help
            User of the broker to connect to
    config BROKER_PASSWORD
        string "Broker password"
        default "mqtt"
        help
            Password of the broker to connect to
endmenu
```

## components/matrix_lcd/Kconfig.projbuild
```kconfig
menu "Matrix LCD I2C configuration "

    config PIN_NUM_SDA
        int "SDA pin"
        range 0 48
        default 8
        help
            SDA pin
 
    config PIN_NUM_SCL
        int "SCL pin"
        range 0 48
        default 9
        help
            SCL pin            
endmenu
```

## components/matrix_spi/Kconfig.projbuild
```kconfig
menu "Matrix SPI configuration "

    config PIN_NUM_MOSI
        int "MOSI pin"
        range 0 48
        default 11
        help
            MOSI pin
 
    config PIN_NUM_CLK
        int "CLK pin"
        range 0 48
        default 12
        help
            CLK pin
 
    config PIN_NUM_CS
        int "CS pin"
        range 0 48
        default 10
        help
            CS pin
            
endmenu
```

## components/time_sync/Kconfig.projbuild
```kconfig
menu "Time Sync Configuration"

    config TIME_SYNC_NTP_UPDATE_PERIOD
        int "NTP Time Update Interval (in hours)"
        default 24
        range 1 24
        help
            The time interval in hours for updating the system time using the NTP server.
            For example, if set to 12, the system will update the time from the NTP server every 12 hours.

endmenu
```

## main/Kconfig.projbuild
```kconfig
menu "MyApp configuration"

    config APP_NAME
        string "Application name"
        default "Web application"
        help
            Name of application.

endmenu
```
